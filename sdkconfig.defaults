## sdkconfig.defaults
```kconfig
CONFIG_IDF_TARGET="esp32s3"

CONFIG_TINYUSB_HID_COUNT=1
CONFIG_TINYUSB_MSC_ENABLED=n
CONFIG_TINYUSB_CDC_ENABLED=n

CONFIG_TINYUSB_DESC_USE_ESPRESSIF_VID=y
CONFIG_TINYUSB_DESC_USE_DEFAULT_PID=y
CONFIG_TINYUSB_DESC_PRODUCT_STRING="ESP32-S3 USB Keyboard"

CONFIG_LOG_DEFAULT_LEVEL=3

# WiFi 配置
CONFIG_ESP_WIFI_STA_ENABLE=y
CONFIG_ESP_WIFI_SOFTAP_ENABLE=n
CONFIG_ESP_WIFI_STATIC_RX_BUFFER_NUM=8
CONFIG_ESP_WIFI_DYNAMIC_RX_BUFFER_NUM=32
CONFIG_ESP_WIFI_TX_BUFFER_TYPE=1
CONFIG_ESP_WIFI_AMPDU_TX_ENABLED=y
CONFIG_ESP_WIFI_AMPDU_RX_ENABLED=y

# LWIP 配置
CONFIG_LWIP_DHCP_DOES_ARP_CHECK=y
CONFIG_LWIP_DHCP_RESTORE_LAST_IP=y
CONFIG_LWIP_MAX_SOCKETS=10

# NVS 分区配置
CONFIG_NVS_ENCRYPTION=n
```
